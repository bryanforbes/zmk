## app/boards/arm/glove80/Kconfig
```kconfig
# Copyright (c) 2021 The ZMK Contributors
# SPDX-License-Identifier: MIT

config BOARD_ENABLE_DCDC
    bool "Enable DCDC mode"
    select SOC_DCDC_NRF52X
    default y
    depends on (BOARD_GLOVE80_LH || BOARD_GLOVE80_RH)

config BT_DEVICE_NAME_APPEND_SN
    bool "Append serial number to BT device name"
    default n
    depends on BT_DEVICE_NAME_DYNAMIC

config BT_DEVICE_NAME_SN_BYTES
    int "Number of bytes of serial number to append to the BT device name"
    default 4
    depends on BT_DEVICE_NAME_APPEND_SN
```

## app/dts/bindings/behaviors/zmk,behavior-caps-word.yaml
```yaml
# Copyright (c) 2021 The ZMK Contributors
# SPDX-License-Identifier: MIT

description: Caps word behavior

compatible: "zmk,behavior-caps-word"

include: zero_param.yaml

properties:
  continue-list:
    type: array
    required: true
    description: |
      List of key codes which should continue the caps word behavior.
      (Alphanumeric keys are included automatically.)
  shift-list:
    type: array
    description: |
      List of key codes which should have modifiers applied when caps word is active.
      (Alpha keys are included automatically.)
  mods:
    type: int
    description: Bitmask of modifiers to apply. Default is MOD_LSFT.
  idle-timeout-ms:
    type: int
    default: 5000
    description: |
      Caps word turns off if no keys are pressed for this duration.
      Set to 0 for caps word to remain active until a word breaking key is pressed
      or caps word is toggled back off.
  no-default-keys:
    type: boolean
    description: Do not automatically include alphanumeric keys in continue-list and shift-list.
```
